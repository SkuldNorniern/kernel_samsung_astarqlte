## drivers/battery_v2/Kconfig
```kconfig
# SPDX-License-Identifier: GPL-2.0
#
# Samsung battery_v2 framework, trimmed to the SM5705 PMIC path.
# MUIC / CCIC / S2MM005 / SM5720 / MFC / LED dependent options are not
# part of this port and are intentionally absent.

config BATTERY_SAMSUNG
	tristate "samsung battery driver"
	help
	 Say Y to include support for samsung battery driver
	 This battery driver integrated all battery-related functions
	 To see battery-related functions,
	 refer to sec_charging_common.h

config BATTERY_SAMSUNG_V2
	tristate "samsung battery driver version 2"
	default n
	depends on BATTERY_SAMSUNG
	help
	 Say Y to include support for samsung battery driver
	 This battery driver integrated all battery-related functions
	 To see battery-related functions,
	 refer to sec_charging_common.h

config BATTERY_SAMSUNG_DATA_FILE
	depends on BATTERY_SAMSUNG
	string "samsung battery data file"
	default "default_battery_data.h"
	help
	 Path to the battery data file.

config SLOW_CHARGING_CURRENT_STANDARD
	int "slow charging"
	depends on BATTERY_SAMSUNG
	default "1000"
	help
	 Value for standard of slow-charging.

config BATTERY_SWELLING
	bool "prevent battery swelling"
	help
	 Say Y to include support for prevent battery swelling

config BATTERY_SWELLING_SELF_DISCHARGING
	bool "prevent battery swelling with self discharging"
	help
	 Say Y to include support for prevent battery swelling with self discharging

config BATTERY_CISD
	bool "support for cisd"
	help
	 Say Y to include support for cisd
	 cisd means cell internal short detection

config BATTERY_AGE_FORECAST
	tristate "battery age forecast"
	default n
	depends on BATTERY_SWELLING
	help
	  Say Y to use calc time to full function.

config BATTERY_NOTIFIER
	bool "battery notifier"
	default n
	help
	  Say Y to enable battery notifier

config SIOP_CHARGING_LIMIT_CURRENT
	int "Siop charging limit current"
	default 0
	help
	  set SIOP charging limit current.

config DISABLE_SAVE_CAPACITY_MAX
	bool "Disable to save capacity max in efs"
	default n
	depends on BATTERY_SAMSUNG
	help
		Say Y to include support to disable it
		capacity_max is saved in /efs/Battery/batt_capacity_max
		capacity_max is restored after boot up

config STORE_MODE
	bool "enable store mode"
	default n
	help
	  Say Y to enable CONFIG_STORE_MODE

config AFC_CHARGER_MODE
	bool "afc charging support in sec battery driver"
	default n
	help
	  Say Y to include support for sec afc charging support

config SAMSUNG_LPM_MODE
	bool "Off charging mode support in sec battery driver"
	default n
	help
	  Say Y to include support for sec off charging support
	  This value defined at bootloader.
	  Before enable this feature,
	  implemet power off charging in the bootloader.

config SAMSUNG_BATTERY_ENG_TEST
	bool "enable ENG mode for battery test"
	default n
	help
	  Say Y to include support for battery test
	  enable this feature only ENG mode
	  this featuren must disabled user binary
	  stability test etc..

config SAMSUNG_BATTERY_FACTORY
	bool "enable for factory test"
	default n
	help
	  Say Y to include support for factory test
	  enable this feature only factory mode
	  this featuren must disabled user binary
	  stability test etc..

# Fuel Gauge

config FUELGAUGE_SM5705
	tristate "Siliconmitus SM5705 Fuel Gauge"
	default n
	depends on I2C
	help
	  SM5705 is fuel-gauge systems for lithium-ion (Li+) batteries
	  in handheld and portable equipment. The SM5705 is configured
	  to operate with a single lithium cell

# Charger

config CHARGER_SM5705
	tristate "SM5705 battery charger support"
	depends on BATTERY_SAMSUNG
	help
	  Say Y here to enable support for the SM5705 charger
```

## drivers/ccic/Kconfig
```kconfig
#
# CCIC devices
#

comment "CCIC configs"

config CCIC_NOTIFIER
	bool "CCIC notifier support"
	depends on I2C
	default n
	help
	  If you say yes here you will get support for
	  the CCIC attached device status change notification.

config CCIC_S2MM005 
	bool "CCIC S2MM005"
	depends on I2C 
	default n
	help
	  If you say yes here you will get support for
	  s2mm005 ccic full version chipset 

config CCIC_S2MM005_ALLOW_FW_WRITE
	bool "Allow s2mm005 firmware/flash writes (sysfs, UMS, boot)"
	depends on CCIC_S2MM005
	default n
	help
	  Every write to the s2mm005 flash (sysfs fw_update, UMS file,
	  flash mode enter/erase/write, boot auto update) is refused with
	  -EPERM unless this is set. Off by default: an interrupted write
	  can leave the chip without firmware. Reads are not affected.

config CCIC_S2MM005_FW_AUTO_UPDATE
	bool "Flash built-in s2mm005 firmware on boot"
	depends on CCIC_S2MM005 && CCIC_S2MM005_ALLOW_FW_WRITE
	default n
	help
	  Stock flashes the built-in firmware when the chip version is
	  older or the product id differs. Off by default: an interrupted
	  write can leave the chip without firmware.

config CCIC_ALTERNATE_MODE 
	bool "support CCIC alternate mode"
	depends on I2C
	default n
	help
	  If you say yes here you will get support for
	  alternate mode

config CCIC_LPM_ENABLE
	bool "Support LPM ENABLE"
	depends on CCIC_S2MM005
	default n
	help
	  If you say yes here you will get support for
	  lpm enable

config CCIC_WATER_DETECT
	bool "support WATER DETECT"
	depends on CCIC_S2MM005
	default n
	help
	  If you say yes here you will get support for
	  water detect Enable

config CCIC_MANUAL_UPDATE
	bool "support CCIC manual update"
	depends on CCIC_S2MM005
	default n
	help
	  If you say yes here you will get support for
	  ccic manual update
```

## drivers/fingerprint/Kconfig
```kconfig
#
# Sensor  drivers configuration
#
menuconfig SENSORS_FINGERPRINT
	bool "Finger Print Sensor devices"
	help
	  Say Y here, and a list of sensors drivers will be displayed.
	  Everything that didn't fit into the other categories is here. This option
	  doesn't affect the kernel.

if SENSORS_FINGERPRINT

config SENSORS_ET5XX
	tristate "ET5XX fingerprint sensor support"
	default n
	help
	  If you say yes here you get support for Egistec's
	  fingerprint sensor ET5XX.

config SENSORS_ET5XX_ALLOW_NVM_WRITE
	bool "Allow ET5XX sensor NVM/VDM writes"
	depends on SENSORS_ET5XX
	default n
	help
	  NVM and VDM write ioctls (FP_NVM_WRITE, FP_NVM_WRITEEX,
	  FP_VDM_WRITE) program the sensor's non-volatile memory. They are
	  refused with -EPERM unless this is set. Off by default. Reads and
	  register access are not affected.

config SENSORS_FP_SPI_NUMBER
	depends on SENSORS_FINGERPRINT
	int "Fingerprint spi bus number"
	default 3
	help
	  spi bus the fingerprint sensor sits on. The TZ owns this QUP and its
	  BAM pipes, so spi_qsd leaves that bus alone (no setup, no clock or
	  register access, no BAM) when ENABLE_SENSORS_FPRINT_SECURE is set.

endif # SENSORS_FINGERPRINT
```

## drivers/input/touchscreen/sec_ts/Kconfig
```kconfig
#
# Samsung Electronics TOUCH driver configuration
#

config SAMSUNG_PRODUCT_SHIP
        bool "Samsung shipping product build"
        default n
        help
          Set for retail firmware: leaves out the sec_ts raw device sysfs
          nodes and the vendor-only debug code.

config TOUCHSCREEN_SEC_TS
        tristate "Samsung Electronics Touchscreen"
        depends on I2C
        select TOUCHSCREEN_SEC_CMD_HELPERS
        help
          Say Y here if you want support for SEC touchscreen controllers.
          If unsure, say N.

          To compile this driver as a module, choose M here: the
          module will be called sec_ts.

config TOUCHSCREEN_SEC_TS_ALLOW_FW_WRITE
	bool "Allow sec_ts chip flash/NVM/calibration writes"
	depends on TOUCHSCREEN_SEC_TS
	default n
	help
	  Firmware/bootloader flashing (probe, sysfs fw_update, UMS/FFU),
	  NVM writes (set nvm, TCLM) and force calibration are refused with
	  -EPERM unless this is set. Off by default: an interrupted write
	  can brick the controller. Reads are not affected.

config TOUCHSCREEN_SEC_TS_GLOVEMODE
        tristate "Samsung Electronics Touchscreen"
        depends on I2C
        help
          Say Y here if you have a Samsung Electronics Touchscreen and want to enable
          support for the built-in touchscreen.

          If unsure, say N.
```

## drivers/input/touchscreen/zinitix/Kconfig
```kconfig
#
# Zinitix Touchscreen driver configuration
#

config TOUCHSCREEN_ZINITIX_ZT75XX_TCLM
	bool "ZINITIX ZT75XX touchscreen driver"
	depends on I2C
	select TOUCHSCREEN_SEC_CMD_HELPERS
	default n
	help
	  Say Y here if you have a ZINITIX ZT75XX touchscreen.
	  If unsure, say N.

config INPUT_TOUCHSCREEN_TCLMV2
	bool "Samsung TCLM v2 touch calibration"
	depends on TOUCHSCREEN_ZINITIX_ZT75XX_TCLM
	default n
	help
	  Enables the TCLM (touch calibration) concept in the ZINITIX driver
	  and builds the sec_tclm_v2 helper.
	  If unsure, say N.

config TOUCHSCREEN_ZINITIX_ALLOW_FW_WRITE
	bool "Allow zinitix chip firmware/EEPROM/TCLM writes"
	depends on TOUCHSCREEN_ZINITIX_ZT75XX_TCLM
	default n
	help
	  Firmware upgrade (probe, sysfs fw_update, misc ioctl), hardware
	  calibration, save-status (EEPROM fuse) and NVM/TCLM writes are
	  refused with -EPERM unless this is set. Off by default: an
	  interrupted flash write can brick the controller. Reads are not
	  affected.

# sec_cmd / sec_tclm_v2 / sec_class: shared by zinitix and sec_ts
config TOUCHSCREEN_SEC_CMD_HELPERS
	bool
```
